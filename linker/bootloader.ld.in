/* Linker script for ATSAMC21G17A cortex-m0plus */
/* Bootloader */
MEMORY{
    flash  (xr ) : ORIGIN = 0x00000000, LENGTH = @GEN_BOOTLOADER_SIZE@ - 256
    eeprom ( r ) : ORIGIN = 0x00000000 + @GEN_BOOTLOADER_SIZE@ - 256, LENGTH = 256 /* main flash */
    ram    (xrw) : ORIGIN = 0x20000000, LENGTH = 16K
}

INCLUDE common_flash.ld
INCLUDE common_eeprom.ld
INCLUDE common_ram.ld

INCLUDE common.ld

